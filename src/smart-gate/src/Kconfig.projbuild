## src/smart-gate/src/Kconfig.projbuild
```kconfig
menu "Smart Gate Configuration"

    orsource "$IDF_PATH/examples/common_components/env_caps/$IDF_TARGET/Kconfig.env_caps"

    choice SMART_GATE_ROLE
        prompt "Smart gate role"

        config SMART_GATE_ENTRY
            bool "ENTRY"
        config SMART_GATE_EXIT
            bool "EXIT"
    endchoice

    menu "I2C Configuration"
        config I2C_MASTER_SCL_GPIO
            int "I2C SCL GPIO number"
            range ENV_GPIO_RANGE_MIN ENV_GPIO_OUT_RANGE_MAX
            default 7

        config I2C_MASTER_SDA_GPIO
            int "I2C SDA GPIO number"
            range ENV_GPIO_RANGE_MIN ENV_GPIO_OUT_RANGE_MAX
            default 5
    endmenu

    menu "SPI Configuration"
        config SPI_MISO_GPIO
            int "SPI MISO GPIO number"
            range ENV_GPIO_RANGE_MIN ENV_GPIO_OUT_RANGE_MAX
            default 19

        config SPI_MOSI_GPIO
            int "SPI MOSI GPIO number"
            range ENV_GPIO_RANGE_MIN ENV_GPIO_OUT_RANGE_MAX
            default 18

        config SPI_SCLK_GPIO
            int "SPI SCLK GPIO number"
            range ENV_GPIO_RANGE_MIN ENV_GPIO_OUT_RANGE_MAX
            default 20

        config SPI_RST_GPIO
            int "SPI RST GPIO number"
            range ENV_GPIO_RANGE_MIN ENV_GPIO_OUT_RANGE_MAX
            default 21
    endmenu

    config SERVO_GPIO
        int "Servo PWM GPIO number"
        range ENV_GPIO_RANGE_MIN ENV_GPIO_OUT_RANGE_MAX
        default 8

    config LCD_ADDR
        int "I2C address of the LCD"
        default 39  # 0x27

    config RC522_SPICS_GPIO
        depends on SMART_GATE_EXIT
        int "SPI SPICS GPIO of the rc522 reader"
        default 21
endmenu
```

## src/smart-parking-space/src/Kconfig.projbuild
```kconfig
menu "Smart Parking Space Configuration"

    orsource "$IDF_PATH/examples/common_components/env_caps/$IDF_TARGET/Kconfig.env_caps"

    menu "LED Configuration"
        config GREEN_LED_GPIO
            int "Green LED GPIO number"
            range ENV_GPIO_RANGE_MIN ENV_GPIO_OUT_RANGE_MAX
            default 12

        config RED_LED_GPIO
            int "Red LED GPIO number"
            range ENV_GPIO_RANGE_MIN ENV_GPIO_OUT_RANGE_MAX
            default 13
    endmenu

    menu "Ultrasonic Configuration"
        config TRIGGER_GPIO
            int "Ultrasonic Trigger GPIO number"
            range ENV_GPIO_RANGE_MIN ENV_GPIO_OUT_RANGE_MAX
            default 4

        menu "Echo GPIO"
            config ECHO_GPIO_1
                int "Ultrasonic 1 Echo GPIO number"
                range ENV_GPIO_RANGE_MIN ENV_GPIO_OUT_RANGE_MAX
                default 7

            config ECHO_GPIO_2
                int "Ultrasonic 2 Echo GPIO number"
                range ENV_GPIO_RANGE_MIN ENV_GPIO_OUT_RANGE_MAX
                default 10

            config ECHO_GPIO_3
                int "Ultrasonic 3 Echo GPIO number"
                range ENV_GPIO_RANGE_MIN ENV_GPIO_OUT_RANGE_MAX
                default 5
        endmenu
    endmenu
endmenu
```
